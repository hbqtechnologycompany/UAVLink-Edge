/dts-v1/;
/plugin/;

/ {
	fragment@0 {
		target = <&sensor0>;
		__overlay__ {
			sensor0_mname = "imx219";
			sensor0_twi_addr = <0x20>;
		};
	};

	/* vinc0_sensor_list = 1: VIN takes the sensor name from this list, not from sensor0 */
	fragment@1 {
		target = <&sensor_list0>;
		__overlay__ {
			sensor00_mname = "imx219";
			sensor00_twi_addr = <0x20>;
		};
	};
};
